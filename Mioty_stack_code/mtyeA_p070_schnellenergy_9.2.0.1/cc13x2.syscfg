/**
 * @cliArgs --board "/ti/boards/CC1352R1_LAUNCHXL" --product "simplelink_cc13xx_cc26xx_sdk@5.30.01.01"
 * @versions {"tool":"1.19.0+3426"}
 */

/**
 * Import the modules used in this configuration.
 */
const CCFG    = scripting.addModule("/ti/devices/CCFG");
const ADC     = scripting.addModule("/ti/drivers/ADC", {}, false);
const ADC1    = ADC.addInstance();
const AESECB  = scripting.addModule("/ti/drivers/AESECB", {}, false);
const AESECB1 = AESECB.addInstance();
const Board   = scripting.addModule("/ti/drivers/Board");
const GPIO    = scripting.addModule("/ti/drivers/GPIO", {}, false);
const GPIO2   = GPIO.addInstance();
const GPIO3   = GPIO.addInstance();
const GPIO4   = GPIO.addInstance();
const GPIO5   = GPIO.addInstance();
const GPIO6   = GPIO.addInstance();
const GPIO7   = GPIO.addInstance();
const GPIO8   = GPIO.addInstance();
const GPIO9   = GPIO.addInstance();
const GPIO10  = GPIO.addInstance();
const GPIO11  = GPIO.addInstance();
const GPIO12  = GPIO.addInstance();
const GPIO13  = GPIO.addInstance();
const GPIO14  = GPIO.addInstance();
const GPIO15  = GPIO.addInstance();
const I2C     = scripting.addModule("/ti/drivers/I2C", {}, false);
const I2C1    = I2C.addInstance();
const NVS     = scripting.addModule("/ti/drivers/NVS", {}, false);
const NVS1    = NVS.addInstance();
const RF      = scripting.addModule("/ti/drivers/RF");
const RTOS    = scripting.addModule("/ti/drivers/RTOS");
const SPI     = scripting.addModule("/ti/drivers/SPI", {}, false);
const SPI1    = SPI.addInstance();
const UART    = scripting.addModule("/ti/drivers/UART", {}, false);
const UART1   = UART.addInstance();
const UART2   = scripting.addModule("/ti/drivers/UART2", {}, false);
const UART21  = UART2.addInstance();

/**
 * Write custom configuration values to the imported modules.
 */
CCFG.enableBootloaderBackdoor = true;
CCFG.dioBootloaderBackdoor    = 15;
CCFG.levelBootloaderBackdoor  = "Active low";
CCFG.forceVddr                = true;
CCFG.ccfgTemplate.$name       = "ti_devices_CCFGTemplate0";

ADC1.$name              = "CONFIG_BAT_SENSE";
ADC1.adc.adcPin.$assign = "boosterpack.2";

AESECB1.$name = "CONFIG_AESECB_0";

GPIO2.$name            = "CONFIG_GPIO_REVERSEPULSE_DIO28";
GPIO2.callbackFunction = "reversePulseCallBack";
GPIO2.interruptTrigger = "Falling Edge";
GPIO2.gpioPin.$assign  = "boosterpack.26";

GPIO3.$name            = "CONFIG_VIBRATION_SENS_DIO18";
GPIO3.callbackFunction = "vibrationSensoeCallback";
GPIO3.interruptTrigger = "Falling Edge";
GPIO3.gpioPin.$assign  = "boosterpack.36";

GPIO4.$name           = "CONFIG_CC1190_PA_EN_DIO3";
GPIO4.mode            = "Output";
GPIO4.gpioPin.$assign = "boosterpack.19";

GPIO5.$name           = "CONFIG_CC1190_LNA_EN_DIO4";
GPIO5.mode            = "Output";
GPIO5.gpioPin.$assign = "boosterpack.9";

GPIO6.$name           = "CONFIG_CC1190_HGM_DIO5";
GPIO6.mode            = "Output";
GPIO6.gpioPin.$assign = "boosterpack.10";

GPIO7.mode               = "Output";
GPIO7.$name              = "CONFIG_GPIO_BOTTOMLED_DIO_11";
GPIO7.initialOutputState = "High";
GPIO7.gpioPin.$assign    = "boosterpack.18";

GPIO8.$name           = "CONFIG_GPIO_MODE_SELECT_DIO26";
GPIO8.mode            = "Output";
GPIO8.gpioPin.$assign = "boosterpack.24";

GPIO9.$name            = "CONFIG_GPIO_REED_SWITCH_DIO27";
GPIO9.callbackFunction = "reedSenseCallBack";
GPIO9.interruptTrigger = "Rising Edge";
GPIO9.gpioPin.$assign  = "boosterpack.25";

GPIO10.mode               = "Output";
GPIO10.$name              = "CONFIG_GPIO_TOP_LED2_DIO30";
GPIO10.initialOutputState = "High";
GPIO10.gpioPin.$assign    = "boosterpack.28";

GPIO11.$name            = "CONFIG_GPIO_FORWARDPULSE_DIO6";
GPIO11.interruptTrigger = "Falling Edge";
GPIO11.callbackFunction = "forwardPulseCallBack";
GPIO11.gpioPin.$assign  = "boosterpack.39";
scripting.suppress("Connected to hardware,@@@.+?@@@ is connected to LaunchPad LED Red on the CC1352R1 LaunchPad\\. Consider selecting it in 'use hardware' above\\. @@@.+?@@@", GPIO11, "gpioPin");

GPIO12.$name           = "CONFIG_GPIO_WATCHDOGTIMER_DONE_DIO10";
GPIO12.mode            = "Output";
GPIO12.gpioPin.$assign = "boosterpack.7";
scripting.suppress("Connected to hardware,@@@.+?@@@ is connected to LaunchPad SPI Bus on the CC1352R1 LaunchPad\\. Consider selecting it in 'use hardware' above\\. @@@.+?@@@", GPIO12, "gpioPin");

GPIO13.$name           = "CONFIG_GPIO_WDT_WAKEUP_DIO9";
GPIO13.pull            = "Pull Down";
GPIO13.gpioPin.$assign = "boosterpack.15";
scripting.suppress("Connected to hardware,@@@.+?@@@ is connected to LaunchPad SPI Bus on the CC1352R1 LaunchPad\\. Consider selecting it in 'use hardware' above\\. @@@.+?@@@", GPIO13, "gpioPin");

GPIO14.mode            = "Output";
GPIO14.$name           = "CONFIG_BAT_VOLTAGE_CRTL_DIO14";
GPIO14.gpioPin.$assign = "boosterpack.12";
scripting.suppress("Connected to hardware,@@@.+?@@@ is connected to LaunchPad Button BTN-2 \\(Right\\) on the CC1352R1 LaunchPad\\. Consider selecting it in 'use hardware' above\\. @@@.+?@@@", GPIO14, "gpioPin");

GPIO15.$name = "CONFIG_EN2_DIO29";
GPIO15.mode  = "Output";

I2C1.$name              = "CONFIG_I2C_0";
I2C1.i2c.sdaPin.$assign = "boosterpack.3";
I2C1.i2c.sclPin.$assign = "boosterpack.4";
scripting.suppress("Connected to hardware,@@@.+?@@@ is connected to XDS110 UART on the CC1352R1 LaunchPad\\. Consider selecting it in 'use hardware' above\\. @@@.+?@@@", I2C1.i2c, "sdaPin");
scripting.suppress("Connected to hardware,@@@.+?@@@ is connected to XDS110 UART on the CC1352R1 LaunchPad\\. Consider selecting it in 'use hardware' above\\. @@@.+?@@@", I2C1.i2c, "sclPin");

NVS1.nvsType                  = "External";
NVS1.$name                    = "CONFIG_NVSEXTERNAL";
NVS1.externalFlash.$name      = "ti_drivers_nvs_NVSSPI25X0";
NVS1.externalFlash.regionSize = 0x200000;

const Power             = scripting.addModule("/ti/drivers/Power", {}, false);
Power.calibrateFunction = "PowerCC26XX_noCalibrate";
Power.calibrateRCOSC_LF = false;
Power.calibrateRCOSC_HF = false;

UART1.$name               = "CONFIG_UART0";
UART1.uart.$assign        = "UART0";
UART1.uart.txPin.$assign  = "boosterpack.13";
UART1.uart.rxPin.$assign  = "boosterpack.40";
UART1.txPinInstance.$name = "CONFIG_PIN_2";
UART1.rxPinInstance.$name = "CONFIG_PIN_3";
scripting.suppress("Connected to hardware,@@@.+?@@@ is connected to LaunchPad Button BTN-1 \\(Left\\) on the CC1352R1 LaunchPad\\. Consider selecting it in 'use hardware' above\\. @@@.+?@@@", UART1.uart, "txPin");
scripting.suppress("Connected to hardware,@@@.+?@@@ is connected to LaunchPad LED Green on the CC1352R1 LaunchPad\\. Consider selecting it in 'use hardware' above\\. @@@.+?@@@", UART1.uart, "rxPin");

UART21.$name              = "CONFIG_UART2_0";
UART21.uart.txPin.$assign = "boosterpack.31";
UART21.uart.rxPin.$assign = "boosterpack.32";

const NVSSPI25XDevice                         = scripting.addModule("/ti/drivers/nvs/NVSSPI25XDevice", {}, false);
const NVSSPI25XDevice1                        = NVSSPI25XDevice.addInstance({}, false);
NVSSPI25XDevice1.$name                        = "CONFIG_NVS_SPI_0";
NVS1.externalFlash.spiFlashDevice             = NVSSPI25XDevice1;
NVSSPI25XDevice1.bitRate                      = 5000000;
NVSSPI25XDevice1.slaveSelect.$assign          = "boosterpack.5";
NVSSPI25XDevice1.slaveSelectPinInstance.$name = "CONFIG_GPIO_0";
NVSSPI25XDevice1.slaveSelectPinInstance.mode  = "Input";

SPI1.$name                         = "CONFIG_SPI_0";
NVSSPI25XDevice1.sharedSpiInstance = SPI1;
SPI1.spi.$assign                   = "SSI0";
SPI1.spi.sclkPin.$assign           = "boosterpack.38";
SPI1.spi.misoPin.$assign           = "boosterpack.8";
SPI1.spi.mosiPin.$assign           = "boosterpack.37";
scripting.suppress("Connected to hardware,@@@.+?@@@ is connected to MX25R8035F SPI Flash Slave Select on the CC1352R1 LaunchPad\\. Consider selecting it in 'use hardware' above\\. @@@.+?@@@", SPI1.spi, "sclkPin");

/**
 * Pinmux solution for unlocked pins/peripherals. This ensures that minor changes to the automatic solver in a future
 * version of the tool will not impact the pinmux you originally saw.  These lines can be completely deleted in order to
 * re-solve from scratch.
 */
ADC1.adc.$suggestSolution              = "ADC0";
GPIO15.gpioPin.$suggestSolution        = "boosterpack.6";
I2C1.i2c.$suggestSolution              = "I2C0";
UART21.uart.$suggestSolution           = "UART1";
SPI1.spi.dmaRxChannel.$suggestSolution = "DMA_CH3";
SPI1.spi.dmaTxChannel.$suggestSolution = "DMA_CH4";
